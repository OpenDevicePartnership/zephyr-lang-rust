## docgen/build/Kconfig/arch/Kconfig
```kconfig
# Load Zephyr Arch Kconfig descriptions.
osource "/home/blake/Repos/zephyr/zephyr-rust/zephyr/arch/rx/Kconfig"
osource "/home/blake/Repos/zephyr/zephyr-rust/zephyr/arch/x86/Kconfig"
osource "/home/blake/Repos/zephyr/zephyr-rust/zephyr/arch/xtensa/Kconfig"
osource "/home/blake/Repos/zephyr/zephyr-rust/zephyr/arch/sparc/Kconfig"
osource "/home/blake/Repos/zephyr/zephyr-rust/zephyr/arch/riscv/Kconfig"
osource "/home/blake/Repos/zephyr/zephyr-rust/zephyr/arch/posix/Kconfig"
osource "/home/blake/Repos/zephyr/zephyr-rust/zephyr/arch/openrisc/Kconfig"
osource "/home/blake/Repos/zephyr/zephyr-rust/zephyr/arch/mips/Kconfig"
osource "/home/blake/Repos/zephyr/zephyr-rust/zephyr/arch/arm64/Kconfig"
osource "/home/blake/Repos/zephyr/zephyr-rust/zephyr/arch/arm/Kconfig"
osource "/home/blake/Repos/zephyr/zephyr-rust/zephyr/arch/arc/Kconfig"
```

## docgen/build/Kconfig/boards/Kconfig.defconfig.tmp
```kconfig
# Load Zephyr board defconfig descriptions.
osource "/home/blake/Repos/zephyr/zephyr-rust/zephyr/boards/native/native_sim/Kconfig.defconfig"
```

## docgen/build/Kconfig/boards/Kconfig.native_sim.tmp
```kconfig
# Load board Kconfig descriptions.
osource "/home/blake/Repos/zephyr/zephyr-rust/zephyr/boards/native/native_sim/Kconfig.native_sim"
```

## docgen/build/Kconfig/boards/Kconfig.sysbuild
```kconfig
# Load Sysbuild board Kconfig descriptions.
osource "/home/blake/Repos/zephyr/zephyr-rust/zephyr/boards/native/native_sim/Kconfig.sysbuild"
```

## docgen/build/Kconfig/soc/Kconfig.soc.tmp
```kconfig
# Load SoC Kconfig descriptions.
osource "/home/blake/Repos/zephyr/zephyr-rust/zephyr/soc/xlnx/zynqmp/Kconfig.soc"
osource "/home/blake/Repos/zephyr/zephyr-rust/zephyr/soc/xlnx/zynq7000/Kconfig.soc"
osource "/home/blake/Repos/zephyr/zephyr-rust/zephyr/soc/xlnx/versalnet/Kconfig.soc"
osource "/home/blake/Repos/zephyr/zephyr-rust/zephyr/soc/xlnx/versal2/Kconfig.soc"
osource "/home/blake/Repos/zephyr/zephyr-rust/zephyr/soc/xlnx/versal/Kconfig.soc"
osource "/home/blake/Repos/zephyr/zephyr-rust/zephyr/soc/xen/Kconfig.soc"
osource "/home/blake/Repos/zephyr/zephyr-rust/zephyr/soc/wch/ch32v/Kconfig.soc"
osource "/home/blake/Repos/zephyr/zephyr-rust/zephyr/soc/ti/simplelink/Kconfig.soc"
osource "/home/blake/Repos/zephyr/zephyr-rust/zephyr/soc/ti/mspm0/Kconfig.soc"
osource "/home/blake/Repos/zephyr/zephyr-rust/zephyr/soc/ti/lm3s6965/Kconfig.soc"
osource "/home/blake/Repos/zephyr/zephyr-rust/zephyr/soc/ti/k3/Kconfig.soc"
osource "/home/blake/Repos/zephyr/zephyr-rust/zephyr/soc/telink/tlsr/Kconfig.soc"
osource "/home/blake/Repos/zephyr/zephyr-rust/zephyr/soc/syna/sr100/Kconfig.soc"
osource "/home/blake/Repos/zephyr/zephyr-rust/zephyr/soc/starfive/jh71xx/Kconfig.soc"
osource "/home/blake/Repos/zephyr/zephyr-rust/zephyr/soc/st/stm32/Kconfig.soc"
osource "/home/blake/Repos/zephyr/zephyr-rust/zephyr/soc/snps/qemu_arc/Kconfig.soc"
osource "/home/blake/Repos/zephyr/zephyr-rust/zephyr/soc/snps/nsim/arc_v/Kconfig.soc"
osource "/home/blake/Repos/zephyr/zephyr-rust/zephyr/soc/snps/nsim/arc_classic/Kconfig.soc"
osource "/home/blake/Repos/zephyr/zephyr-rust/zephyr/soc/snps/hsdk4xd/Kconfig.soc"
osource "/home/blake/Repos/zephyr/zephyr-rust/zephyr/soc/snps/hsdk/Kconfig.soc"
osource "/home/blake/Repos/zephyr/zephyr-rust/zephyr/soc/snps/emsk/Kconfig.soc"
osource "/home/blake/Repos/zephyr/zephyr-rust/zephyr/soc/snps/emsdp/Kconfig.soc"
osource "/home/blake/Repos/zephyr/zephyr-rust/zephyr/soc/snps/arc_iot/Kconfig.soc"
osource "/home/blake/Repos/zephyr/zephyr-rust/zephyr/soc/silabs/Kconfig.soc"
osource "/home/blake/Repos/zephyr/zephyr-rust/zephyr/soc/sifli/sf32/Kconfig.soc"
osource "/home/blake/Repos/zephyr/zephyr-rust/zephyr/soc/sifive/sifive_freedom/Kconfig.soc"
osource "/home/blake/Repos/zephyr/zephyr-rust/zephyr/soc/sensry/Kconfig.soc"
osource "/home/blake/Repos/zephyr/zephyr-rust/zephyr/soc/rockchip/Kconfig.soc"
osource "/home/blake/Repos/zephyr/zephyr-rust/zephyr/soc/renode/riscv_virtual/Kconfig.soc"
osource "/home/blake/Repos/zephyr/zephyr-rust/zephyr/soc/renode/cortex_r8_virtual/Kconfig.soc"
osource "/home/blake/Repos/zephyr/zephyr-rust/zephyr/soc/renesas/smartbond/Kconfig.soc"
osource "/home/blake/Repos/zephyr/zephyr-rust/zephyr/soc/renesas/rz/Kconfig.soc"
osource "/home/blake/Repos/zephyr/zephyr-rust/zephyr/soc/renesas/rx/Kconfig.soc"
osource "/home/blake/Repos/zephyr/zephyr-rust/zephyr/soc/renesas/rcar/Kconfig.soc"
osource "/home/blake/Repos/zephyr/zephyr-rust/zephyr/soc/renesas/ra/Kconfig.soc"
osource "/home/blake/Repos/zephyr/zephyr-rust/zephyr/soc/realtek/fingerprint/Kconfig.soc"
osource "/home/blake/Repos/zephyr/zephyr-rust/zephyr/soc/realtek/ec/Kconfig.soc"
osource "/home/blake/Repos/zephyr/zephyr-rust/zephyr/soc/realtek/bee/Kconfig.soc"
osource "/home/blake/Repos/zephyr/zephyr-rust/zephyr/soc/realtek/ameba/Kconfig.soc"
osource "/home/blake/Repos/zephyr/zephyr-rust/zephyr/soc/raspberrypi/rpi_pico/Kconfig.soc"
osource "/home/blake/Repos/zephyr/zephyr-rust/zephyr/soc/quicklogic/eos_s3/Kconfig.soc"
osource "/home/blake/Repos/zephyr/zephyr-rust/zephyr/soc/qemu/virt_riscv/Kconfig.soc"
osource "/home/blake/Repos/zephyr/zephyr-rust/zephyr/soc/qemu/or1k/Kconfig.soc"
osource "/home/blake/Repos/zephyr/zephyr-rust/zephyr/soc/qemu/malta/Kconfig.soc"
osource "/home/blake/Repos/zephyr/zephyr-rust/zephyr/soc/openisa/rv32m1/Kconfig.soc"
osource "/home/blake/Repos/zephyr/zephyr-rust/zephyr/soc/openhwgroup/cva6/Kconfig.soc"
osource "/home/blake/Repos/zephyr/zephyr-rust/zephyr/soc/oct/osd32mp15x/Kconfig.soc"
osource "/home/blake/Repos/zephyr/zephyr-rust/zephyr/soc/nxp/s32/Kconfig.soc"
osource "/home/blake/Repos/zephyr/zephyr-rust/zephyr/soc/nxp/rw/Kconfig.soc"
osource "/home/blake/Repos/zephyr/zephyr-rust/zephyr/soc/nxp/mcx/Kconfig.soc"
osource "/home/blake/Repos/zephyr/zephyr-rust/zephyr/soc/nxp/lpc/Kconfig.soc"
osource "/home/blake/Repos/zephyr/zephyr-rust/zephyr/soc/nxp/layerscape/Kconfig.soc"
osource "/home/blake/Repos/zephyr/zephyr-rust/zephyr/soc/nxp/kinetis/Kconfig.soc"
osource "/home/blake/Repos/zephyr/zephyr-rust/zephyr/soc/nxp/imxrt/Kconfig.soc"
osource "/home/blake/Repos/zephyr/zephyr-rust/zephyr/soc/nxp/imx/Kconfig.soc"
osource "/home/blake/Repos/zephyr/zephyr-rust/zephyr/soc/nuvoton/numicro/Kconfig.soc"
osource "/home/blake/Repos/zephyr/zephyr-rust/zephyr/soc/nuvoton/numaker/Kconfig.soc"
osource "/home/blake/Repos/zephyr/zephyr-rust/zephyr/soc/nuvoton/npcx/Kconfig.soc"
osource "/home/blake/Repos/zephyr/zephyr-rust/zephyr/soc/nuvoton/npcm/Kconfig.soc"
osource "/home/blake/Repos/zephyr/zephyr-rust/zephyr/soc/nordic/Kconfig.soc"
osource "/home/blake/Repos/zephyr/zephyr-rust/zephyr/soc/neorv32/Kconfig.soc"
osource "/home/blake/Repos/zephyr/zephyr-rust/zephyr/soc/native/inf_clock/Kconfig.soc"
osource "/home/blake/Repos/zephyr/zephyr-rust/zephyr/soc/microchip/sam/sama7/Kconfig.soc"
osource "/home/blake/Repos/zephyr/zephyr-rust/zephyr/soc/microchip/sam/sam_d5x_e5x/Kconfig.soc"
osource "/home/blake/Repos/zephyr/zephyr-rust/zephyr/soc/microchip/pic64/Kconfig.soc"
osource "/home/blake/Repos/zephyr/zephyr-rust/zephyr/soc/microchip/pic32c/pic32cz_ca/Kconfig.soc"
osource "/home/blake/Repos/zephyr/zephyr-rust/zephyr/soc/microchip/pic32c/pic32cx_sg/Kconfig.soc"
osource "/home/blake/Repos/zephyr/zephyr-rust/zephyr/soc/microchip/pic32c/pic32cm_pl/Kconfig.soc"
osource "/home/blake/Repos/zephyr/zephyr-rust/zephyr/soc/microchip/pic32c/pic32cm_jh/Kconfig.soc"
osource "/home/blake/Repos/zephyr/zephyr-rust/zephyr/soc/microchip/miv/Kconfig.soc"
osource "/home/blake/Repos/zephyr/zephyr-rust/zephyr/soc/microchip/mec/Kconfig.soc"
osource "/home/blake/Repos/zephyr/zephyr-rust/zephyr/soc/mediatek/mt8xxx/Kconfig.soc"
osource "/home/blake/Repos/zephyr/zephyr-rust/zephyr/soc/lowrisc/opentitan/Kconfig.soc"
osource "/home/blake/Repos/zephyr/zephyr-rust/zephyr/soc/litex/litex_vexriscv/Kconfig.soc"
osource "/home/blake/Repos/zephyr/zephyr-rust/zephyr/soc/ite/ec/Kconfig.soc"
osource "/home/blake/Repos/zephyr/zephyr-rust/zephyr/soc/intel/wildcat_lake/Kconfig.soc"
osource "/home/blake/Repos/zephyr/zephyr-rust/zephyr/soc/intel/raptor_lake/Kconfig.soc"
osource "/home/blake/Repos/zephyr/zephyr-rust/zephyr/soc/intel/panther_lake/Kconfig.soc"
osource "/home/blake/Repos/zephyr/zephyr-rust/zephyr/soc/intel/lakemont/Kconfig.soc"
osource "/home/blake/Repos/zephyr/zephyr-rust/zephyr/soc/intel/intel_socfpga_std/Kconfig.soc"
osource "/home/blake/Repos/zephyr/zephyr-rust/zephyr/soc/intel/intel_socfpga/Kconfig.soc"
osource "/home/blake/Repos/zephyr/zephyr-rust/zephyr/soc/intel/intel_niosv/Kconfig.soc"
osource "/home/blake/Repos/zephyr/zephyr-rust/zephyr/soc/intel/intel_ish/Kconfig.soc"
osource "/home/blake/Repos/zephyr/zephyr-rust/zephyr/soc/intel/intel_adsp/Kconfig.soc"
osource "/home/blake/Repos/zephyr/zephyr-rust/zephyr/soc/intel/elkhart_lake/Kconfig.soc"
osource "/home/blake/Repos/zephyr/zephyr-rust/zephyr/soc/intel/atom/Kconfig.soc"
osource "/home/blake/Repos/zephyr/zephyr-rust/zephyr/soc/intel/apollo_lake/Kconfig.soc"
osource "/home/blake/Repos/zephyr/zephyr-rust/zephyr/soc/intel/alder_lake/Kconfig.soc"
osource "/home/blake/Repos/zephyr/zephyr-rust/zephyr/soc/infineon/psoc4/Kconfig.soc"
osource "/home/blake/Repos/zephyr/zephyr-rust/zephyr/soc/infineon/edge/Kconfig.soc"
osource "/home/blake/Repos/zephyr/zephyr-rust/zephyr/soc/infineon/cat3/Kconfig.soc"
osource "/home/blake/Repos/zephyr/zephyr-rust/zephyr/soc/infineon/cat1c/Kconfig.soc"
osource "/home/blake/Repos/zephyr/zephyr-rust/zephyr/soc/infineon/cat1b/Kconfig.soc"
osource "/home/blake/Repos/zephyr/zephyr-rust/zephyr/soc/infineon/cat1a/Kconfig.soc"
osource "/home/blake/Repos/zephyr/zephyr-rust/zephyr/soc/gd/gd32/Kconfig.soc"
osource "/home/blake/Repos/zephyr/zephyr-rust/zephyr/soc/gaisler/leon3/Kconfig.soc"
osource "/home/blake/Repos/zephyr/zephyr-rust/zephyr/soc/gaisler/gr716a/Kconfig.soc"
osource "/home/blake/Repos/zephyr/zephyr-rust/zephyr/soc/focaltech/Kconfig.soc"
osource "/home/blake/Repos/zephyr/zephyr-rust/zephyr/soc/espressif/Kconfig.soc"
osource "/home/blake/Repos/zephyr/zephyr-rust/zephyr/soc/ene/kb1200/Kconfig.soc"
osource "/home/blake/Repos/zephyr/zephyr-rust/zephyr/soc/ene/kb106x/Kconfig.soc"
osource "/home/blake/Repos/zephyr/zephyr-rust/zephyr/soc/elan/em32f967/Kconfig.soc"
osource "/home/blake/Repos/zephyr/zephyr-rust/zephyr/soc/egis/Kconfig.soc"
osource "/home/blake/Repos/zephyr/zephyr-rust/zephyr/soc/efinix/sapphire/Kconfig.soc"
osource "/home/blake/Repos/zephyr/zephyr-rust/zephyr/soc/cdns/xtensa_sample_controller/Kconfig.soc"
osource "/home/blake/Repos/zephyr/zephyr-rust/zephyr/soc/cdns/swerv/Kconfig.soc"
osource "/home/blake/Repos/zephyr/zephyr-rust/zephyr/soc/cdns/sample_controller32/Kconfig.soc"
osource "/home/blake/Repos/zephyr/zephyr-rust/zephyr/soc/cdns/dc233c/Kconfig.soc"
osource "/home/blake/Repos/zephyr/zephyr-rust/zephyr/soc/brcm/bcmvk/Kconfig.soc"
osource "/home/blake/Repos/zephyr/zephyr-rust/zephyr/soc/brcm/bcm2712/Kconfig.soc"
osource "/home/blake/Repos/zephyr/zephyr-rust/zephyr/soc/brcm/bcm2711/Kconfig.soc"
osource "/home/blake/Repos/zephyr/zephyr-rust/zephyr/soc/blackberry/qnxhv_vm/Kconfig.soc"
osource "/home/blake/Repos/zephyr/zephyr-rust/zephyr/soc/bflb/Kconfig.soc"
osource "/home/blake/Repos/zephyr/zephyr-rust/zephyr/soc/atmel/sam0/Kconfig.soc"
osource "/home/blake/Repos/zephyr/zephyr-rust/zephyr/soc/atmel/sam/Kconfig.soc"
osource "/home/blake/Repos/zephyr/zephyr-rust/zephyr/soc/aspeed/Kconfig.soc"
osource "/home/blake/Repos/zephyr/zephyr-rust/zephyr/soc/arm/Kconfig.soc"
osource "/home/blake/Repos/zephyr/zephyr-rust/zephyr/soc/arm/beetle/Kconfig.soc"
osource "/home/blake/Repos/zephyr/zephyr-rust/zephyr/soc/antmicro/myra/Kconfig.soc"
osource "/home/blake/Repos/zephyr/zephyr-rust/zephyr/soc/andestech/Kconfig.soc"
osource "/home/blake/Repos/zephyr/zephyr-rust/zephyr/soc/amd/acp_6_0/Kconfig.soc"
osource "/home/blake/Repos/zephyr/zephyr-rust/zephyr/soc/ambiq/Kconfig.soc"
osource "/home/blake/Repos/zephyr/zephyr-rust/zephyr/soc/allwinner/sun8i_h3/Kconfig.soc"
osource "/home/blake/Repos/zephyr/zephyr-rust/zephyr/soc/alif/ensemble/Kconfig.soc"
osource "/home/blake/Repos/zephyr/zephyr-rust/zephyr/soc/aesc/Kconfig.soc"
osource "/home/blake/Repos/zephyr/zephyr-rust/zephyr/soc/adi/max32/Kconfig.soc"
```

## samples/blocking/sample.yaml
```yaml
sample:
  description: Offloading blocking Zephyr calls onto a worker thread pool
  name: blocking offload pool
common:
  harness: console
  harness_config:
    type: multi_line
    ordered: false
    regex:
      - "fast finished a 200 ms blocking call"
      - "slow finished a 700 ms blocking call"
  tags: rust
  filter: CONFIG_RUST_SUPPORTED
  platform_allow:
    - native_sim/native/64
    - qemu_cortex_m3
    - qemu_riscv32
    - qemu_riscv64
tests:
  sample.rust.blocking:
    tags: introduction
```

## samples/thermal-service/build/Kconfig/boards/Kconfig.defconfig
```kconfig
# Load Zephyr board defconfig descriptions.
osource "/home/blake/Repos/zephyr/zephyr-rust/zephyr/boards/nxp/mimxrt685_evk/Kconfig.defconfig"
```

## samples/thermal-service/build/Kconfig/boards/Kconfig.mimxrt685_evk
```kconfig
# Load board Kconfig descriptions.
osource "/home/blake/Repos/zephyr/zephyr-rust/zephyr/boards/nxp/mimxrt685_evk/Kconfig.mimxrt685_evk"
```

## samples/thermal-service/drivers/mock_temp_sensor/Kconfig
```kconfig
# SPDX-License-Identifier: Apache-2.0

config MOCK_TEMP_SENSOR
	bool "Mock temperature sensor"
	default y
	depends on DT_HAS_ZEPHYR_MOCK_TEMP_SENSOR_ENABLED
	help
	  Enable mock temperature sensor driver for testing without hardware.
```

## samples/zephyr-odp/dts/bindings/zephyr,fuel-gauge-emul.yaml
```yaml
# Copyright (c) 2024 Blake Smith
# SPDX-License-Identifier: Apache-2.0

description: Emulated fuel gauge device for testing

compatible: "zephyr,fuel-gauge-emul"

include: fuel-gauge.yaml
```

## samples/zephyr-odp/dts/bindings/zephyr,pwm-emul.yaml
```yaml
# Copyright (c) 2026
# SPDX-License-Identifier: Apache-2.0

description: |
    Emulated PWM controller for testing without hardware.

compatible: "zephyr,pwm-emul"

include: [pwm-controller.yaml, base.yaml]

properties:
  "#pwm-cells":
    const: 3

  frequency:
    type: int
    default: 1000000
    description: |
      Frequency of the emulated underlying timer, in Hz.

pwm-cells:
  - channel
  - period
  - flags
```
